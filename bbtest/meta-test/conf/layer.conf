## bbtest/meta-test/conf/layer.conf
```bitbake
# We have a metadata layer directory, add to BBPATH
BBPATH .= ":${LAYERDIR}"

# We have a recipe directory, add to BBFILES
BBFILES += "${LAYERDIR}/recipes-*/*/*.bb \
            ${LAYERDIR}/recipes-*/*/*.bbappend"

BBFILE_COLLECTIONS += "test"
BBFILE_PATTERN_test := "^${LAYERDIR}/"
BBFILE_PRIORITY_test = "5"
```
